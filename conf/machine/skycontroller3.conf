## conf/machine/skycontroller3.conf
```bitbake
#@TYPE: Machine
#@NAME: Skycontroller3-yocto machine
#@DESCRIPTION: Machine configuration for Parrot Skycontroller3

MACHINE_EXTRA_RRECOMMENDS = "kernel-modules kernel-devicetree"

KERNEL_MODULE_AUTOLOAD += "g_ether usb_f_eem"
MACHINE_ESSENTIAL_EXTRA_RRECOMMENDS += "kernel-module-g-ether kernel-module-usb-f-eem"

DEFAULTTUNE ?= "cortexa7"
include conf/machine/include/tune-cortexa7.inc

IMAGE_FSTYPES += "tar.bz2 ubi"
MKUBIFS_ARGS = " -m 2048 -e 126976 -c 468 "
UBINIZE_ARGS = " -p 128KiB -m 2048 -s 2048 "
UBI_VOLNAME = "rootfs"

IMAGE_INSTALL_append = " kernel-devicetree kernel-image-zimage"

SERIAL_CONSOLES ?= "115200;ttyS0 115200;ttyO0"
SERIAL_CONSOLES_CHECK = "${SERIAL_CONSOLES}"

PREFERRED_PROVIDER_virtual/kernel ?= "linux-skycontroller3"
PREFERRED_VERSION_linux-skycontroller3 ?= "3.18.31"

KERNEL_IMAGETYPE = "zImage"
KERNEL_DEVICETREE += "msm8909-pm8916-mpp3-hw00.dtb"

MACHINE_FEATURES = "usbgadget usbhost vfat alsa"
```

## recipes-kernel/linux/files/Kconfig.patch
```kconfig
--- linux-3.18.31/drivers/Kconfig	2019-06-26 21:26:58.000000000 +0200
+++ linux-3.18.31/drivers/Kconfig.patched	2021-01-22 22:45:05.236322738 +0100
@@ -1,6 +1,6 @@
 menu "Device Drivers"
 
-source "drivers/parrot/Kconfig
+source "drivers/parrot/Kconfig"
 
 source "drivers/base/Kconfig"
 
```
